## drivers/net/ethernet/lsi/Kconfig
```kconfig
config LSI_NET
	bool "LSI ACP34XX Ethernet support"
	select MII
	select PHYLIB
	help
	  Network interface driver for LSI's APP and AXXIA series boards.

if LSI_NET

config LSI_NET_NUM_RX_DESC
	int "LSI Axxia Network Driver: Number of receive descriptors"
	depends on LSI_NET
	default "4"
	help
          The number of receive descriptors to allocate.

config LSI_NET_RX_BUF_SZ
	int "NIC driver: Size of the receive buffer"
	depends on LSI_NET
	default "32768"
	help
          The size of the receive buffer.

config LSI_NET_NUM_TX_DESC
	int "NIC driver: Number of transmit descriptors"
	depends on LSI_NET
	default "4"
	help
	  The number of transmit descriptors to allocate.

config LSI_NET_TX_BUF_SZ
	int "NIC driver: Size of the transmit buffer"
	depends on LSI_NET
	default "32768"
	help
	  The size of the transmit buffer.

config DISABLE_TX_INTERRUPTS
	bool "NIC driver: Disable Tx interrupts"
	depends on LSI_NET
	default y
	help
	  If set to "yes", disables Transmit interrupts

config PRELOAD_RX_BUFFERS
	bool "NIC driver: Preload Rx buffers"
	depends on LSI_NET
	default n
	help
	  If set to "yes", enables preloading of Rx buffer prior to
	  copying into device

endif # LSI_NET
```

## drivers/rapidio/Kconfig
```kconfig
#
# RapidIO configuration
#
source "drivers/rapidio/devices/Kconfig"

config RAPIDIO_DISC_TIMEOUT
	int "Discovery timeout duration (seconds)"
	depends on RAPIDIO
	default "30"
	---help---
	  Amount of time a discovery node waits for a host to complete
	  enumeration before giving up.

config RAPIDIO_ENABLE_RX_TX_PORTS
	bool "Enable RapidIO Input/Output Ports"
	depends on RAPIDIO
	---help---
	  The RapidIO specification describes a Output port transmit
	  enable and a Input port receive enable. The recommended state
	  for Input ports and Output ports should be disabled. When
	  this switch is set the RapidIO subsystem will enable all
	  ports for Input/Output direction to allow other traffic
	  than Maintenance transfers.

config RAPIDIO_DIO_DMA
       bool "Use DMA for direct I/O access"
       depends on RAPIDIO
       default n
       select DMA_ENGINE
       ---help---
         Say Y here if you want the RapidIO driver to use DMA for direct I/O
	 data transfers.

config RAPIDIO_ACCESS_ERR_LIMIT
       int "Number of device access errors accepted during net configuration, before giving up."
       depends on RAPIDIO
       default 0
       ---help---
         RIO net setup will be aborted if the core driver discovers that
	 contact is lost to devices, which has previously been probed, during
	 final LUT setup phase.
	 Failed SRIO access attempts may result in machine check errors:
	 Depending on SRIO port controller, the SRIO driver may have the
	 ability to recover from such faults. If your port controller supports
	 MC recovery for SRIO access errors you may chose to tolerate a certain
	 number of faults.
	 MC fault recovery, however, take some time and the user is advised
	 not to set this value to high.

config RAPIDIO_DYNAMIC_ROUTES
       bool "Use dynamic routing (Experimental)"
       depends on RAPIDIO
       default n
       ---help---
         Say Y here if you want the RapidIO driver to use dynamic routing and
	 calculate and adopt to the cheapest path between nodes.

config RAPIDIO_MULTICAST_PW
       bool "Port Write Multicast (Experimental)"
       depends on RAPIDIO
       default n
       ---help---
         Say Y here if you want the RapidIO driver to enable multicast of
	 prot write messages.

config RAPIDIO_HOTPLUG
       bool "Support for RAPIDIO Hotplug"
       depends on RAPIDIO && HOTPLUG && SYSFS
       default n
       ---help---
         This allows you to add and remove RIO devices while the machine is
         powered up and running.

         When in doubt, say N.

config RAPIDIO_STATIC_DESTID
       bool "Use static RIO device destID"
       depends on RAPIDIO
       default n
       ---help---
         The default enumeration mode in the rapidio driver is to assign destIDs
	 to RIO devices dynamically. If you say Y here, the rapidio driver allows
	 static or user defined numbering.

config RAPIDIO_ENUM_DOMAIN
       bool "Support multiple enumeration hosts in the RIO network (Experimental)"
       depends on RAPIDIO && RAPIDIO_HOTPLUG && RAPIDIO_STATIC_DESTID
       default n
       ---help---
         Support multiple enumeration hosts in the RIO network

config RAPIDIO_SECOND_DEST_ID
         hex "Add a second destination id to main RIO port"
         depends on RAPIDIO_HOTPLUG
         default "0xdc"
         ---help---
	   Add a second destination id that will be recognized by the main RIO
           port. Can for example be used to receive multicasts or equivalent
	   that has multiple recipients.

config RAPIDIO_PW_MULTICAST_MASK_ID
       int "Multicast mask id to use for multicast port writes in switches"
       depends on RAPIDIO_HOTPLUG
       default "1"
       ---help---
	 When using domains we need to multicast all port writes to all
	 domains. For this we need to set up a multicast mask dedicated for
	 this on all switches. This is the number for that mask.

config RAPIDIO_DEBUG
	bool "RapidIO subsystem debug messages"
	depends on RAPIDIO
	help
	  Say Y here if you want the RapidIO subsystem to produce a bunch of
	  debug messages to the system log. Select this if you are having a
	  problem with the RapidIO subsystem and want to see more of what is
	  going on.

	  If you are unsure about this, say N here.

source "drivers/rapidio/switches/Kconfig"
```

## drivers/rapidio/devices/lsi/Kconfig
```kconfig
config AXXIA_RIO
	bool "LSI Embedded SRIO Controller support"
	depends on RAPIDIO && (ACP || ARCH_AXXIA)
	default "n"
	---help---
	  Include support for RapidIO controller for LSI Axxia

config RIO_MAINT_WIN_SIZE
       hex "RIO mport maintenance window size"
       depends on RAPIDIO
       default "0x400000"
       ---help---
         Size of RAPIDIO maintenance transaction window.
         If RapidIO LAW size in your platform is less than 0x400000,
         you may use this option to adjust the maintenance transaction
         window accordingly.

config RIO_MAX_IRQS
       hex "AXXIA RIO Interrupt queue size"
       depends on RAPIDIO
       default "0x20"
       ---help---
         Number of interrupt service requests that are accepted before
	 the AXXIA RapidIO port driver asserts backpressure.

config AXXIA_RIO_STAT
       bool "AXXIA RIO driver statistics"
       depends on AXXIA_RIO
       default n
       ---help---
	If you say Y here, you will be able to view state and interrupt
	 counters for the Axxia RapidIO controller via sysfs.

config SRIO_IRQ_TIME
       bool "AXXIA RIO IB DME IRQ latency statistics"
       depends on AXXIA_RIO
       select AXXIA_RIO_STAT
       default n
       ---help---
	If you say Y here, timestamps may be added to inbound message
	 payload. Enable/Disable is controller via sysfs.

config AXXIA_RIO_16B_ID
       bool "RapidIO large common transport system"
	 depends on AXXIA_RIO
	 default n
	 ---help---
	   Say yes here to enable use of 16 bit transport ID otherwise
	   transport ID has 8 bits.

config AXXIA_RIO_DEBUG
        bool "Switch on debug info for AXXIA RIO driver"
        depends on AXXIA_RIO
        default n
```
